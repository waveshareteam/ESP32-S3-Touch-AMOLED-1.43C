## examples/factory/components/esp32_s3_touch_amoled_1_43c/Kconfig
```kconfig
menu "ESP32-S3 Touch AMOLED 1.43C BSP"
    config BSP_LVGL_TASK_STACK_SIZE
        int "LVGL task stack size (bytes)"
        range 8192 32768
        default 16384
        help
            Stack for the round desktop's rendering and APP event callbacks.
    config BSP_LCD_SPI_CLOCK_HZ
        int "LCD QSPI clock (Hz)"
        range 10000000 80000000
        default 40000000
    config BSP_LCD_BUFFER_HEIGHT
        int "LVGL draw buffer height"
        range 10 466
        default 16
    config BSP_LCD_BRIGHTNESS
        int "Initial display brightness percentage"
        range 0 100
        default 100
endmenu
```

## examples/factory/sdkconfig.defaults
```kconfig
CONFIG_IDF_TARGET="esp32s3"
CONFIG_ESPTOOLPY_FLASHMODE_QIO=y
CONFIG_ESPTOOLPY_FLASHSIZE_8MB=y
CONFIG_PARTITION_TABLE_CUSTOM=y
CONFIG_COMPILER_OPTIMIZATION_PERF=y
CONFIG_SPIRAM=y
CONFIG_SPIRAM_MODE_OCT=y
CONFIG_SPIRAM_FETCH_INSTRUCTIONS=y
# Keep fonts/images in Flash so voice processing has enough PSRAM.
CONFIG_SPIRAM_RODATA=n
CONFIG_SPIRAM_SPEED_80M=y
CONFIG_SPIRAM_MALLOC_ALWAYSINTERNAL=0
CONFIG_SPIRAM_TRY_ALLOCATE_WIFI_LWIP=y
CONFIG_ESP_DEFAULT_CPU_FREQ_MHZ_240=y
# Desktop creation and bsp_display_show() render the first frame on app_main.
CONFIG_ESP_MAIN_TASK_STACK_SIZE=12288
CONFIG_BSP_LVGL_TASK_STACK_SIZE=16384
CONFIG_ESP_CONSOLE_UART_CUSTOM=y
CONFIG_ESP_CONSOLE_UART_BAUDRATE=2000000
CONFIG_FREERTOS_HZ=1000
CONFIG_ESP_BROOKESIA_ENABLE_AI_FRAMEWORK=n
CONFIG_ESP_BROOKESIA_GUI_ENABLE_ANIM_PLAYER=n
CONFIG_ESP_BROOKESIA_ENABLE_SERVICES=n
CONFIG_ESP_BROOKESIA_SYSTEMS_ENABLE_SPEAKER=n
CONFIG_BOOST_MATH_ENABLED=n
CONFIG_BOOST_SERIALIZATION_ENABLED=n
CONFIG_LV_USE_CLIB_MALLOC=y
CONFIG_LV_USE_CLIB_STRING=y
CONFIG_LV_USE_CLIB_SPRINTF=y
CONFIG_LV_OS_FREERTOS=y
CONFIG_LV_DEF_REFR_PERIOD=15
CONFIG_LV_OBJ_STYLE_CACHE=y
CONFIG_LV_DRAW_SW_DRAW_UNIT_CNT=2
CONFIG_SPIRAM_XIP_FROM_PSRAM=n
CONFIG_ESP32S3_INSTRUCTION_CACHE_32KB=y
CONFIG_ESP32S3_DATA_CACHE_64KB=y
CONFIG_ESP32S3_DATA_CACHE_LINE_64B=y
CONFIG_COMPILER_OPTIMIZATION_PERF=y
CONFIG_ESP_LVGL_ADAPTER_ENABLE_FPS_STATS=y

# Integrated Xiaozhi APP, using ES8311 output and ES7210 input.
CONFIG_FREERTOS_TASK_CREATE_ALLOW_EXT_MEM=y
CONFIG_SR_WN_WN9_NIHAOXIAOZHI_TTS=y
CONFIG_XIAOZHI_APP_UI_LANGUAGE_ENGLISH=y
CONFIG_XIAOZHI_APP_TRANSPORT_WEBSOCKET=y
CONFIG_XIAOZHI_INFO_TIMEOUT_MS=8000
CONFIG_XIAOZHI_SYNC_SYSTEM_TIME_FROM_SERVER=n
CONFIG_MBEDTLS_CERTIFICATE_BUNDLE=y
CONFIG_MBEDTLS_EXTERNAL_MEM_ALLOC=y
CONFIG_LV_FONT_MONTSERRAT_12=y
CONFIG_LV_FONT_MONTSERRAT_16=y
CONFIG_LV_FONT_MONTSERRAT_20=y
CONFIG_LV_FONT_MONTSERRAT_32=y
CONFIG_CODEC_I2C_BACKWARD_COMPATIBLE=n
CONFIG_LV_FONT_SOURCE_HAN_SANS_SC_16_CJK=y
CONFIG_LV_USE_QRCODE=y
CONFIG_LWIP_SNTP_MAX_SERVERS=2
CONFIG_BSP_LCD_BUFFER_HEIGHT=16

CONFIG_LV_FONT_MONTSERRAT_18=y
CONFIG_LV_FONT_MONTSERRAT_24=y
CONFIG_LV_FONT_MONTSERRAT_26=y
CONFIG_LV_FONT_MONTSERRAT_42=y
```
